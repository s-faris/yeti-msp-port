/**
 * @cliArgs --device "MSPM0G350X" --part "Default" --package "LQFP-64(PM)" --product "mspm0_sdk@2.04.00.06"
 * @versions {"tool":"1.23.1+4034"}
 */

/**
 * Import the modules used in this configuration.
 */
const ADC12  = scripting.addModule("/ti/driverlib/ADC12", {}, false);
const ADC121 = ADC12.addInstance();
const ADC122 = ADC12.addInstance();
const CRC    = scripting.addModule("/ti/driverlib/CRC");
const DMA    = scripting.addModule("/ti/driverlib/DMA");
const TIMER  = scripting.addModule("/ti/driverlib/TIMER", {}, false);
const TIMER1 = TIMER.addInstance();
const TIMER2 = TIMER.addInstance();
const TIMER3 = TIMER.addInstance();

/**
 * Write custom configuration values to the imported modules.
 */
const divider7       = system.clockTree["PLL_PDIV"];
divider7.divideValue = 4;

const divider9       = system.clockTree["UDIV"];
divider9.divideValue = 2;

const multiplier2         = system.clockTree["PLL_QDIV"];
multiplier2.multiplyValue = 20;

const mux8       = system.clockTree["HSCLKMUX"];
mux8.inputSelect = "HSCLKMUX_SYSPLL0";

ADC121.$name                   = "ADC12_0";
ADC121.sampClkDiv              = "DL_ADC12_CLOCK_DIVIDE_16";
ADC121.samplingOperationMode   = "sequence";
ADC121.endAdd                  = 5;
ADC121.adcMem0_name            = "temp";
ADC121.configureDMA            = true;
ADC121.sampCnt                 = 6;
ADC121.enabledDMATriggers      = ["DL_ADC12_DMA_MEM5_RESULT_LOADED"];
ADC121.sampClkSrc              = "DL_ADC12_CLOCK_ULPCLK";
ADC121.adcPin0Config.$name     = "ti_driverlib_gpio_GPIOPinGeneric0";
ADC121.DMA_CHANNEL.$name       = "DMA_CH0";
ADC121.DMA_CHANNEL.addressMode = "f2b";

ADC122.$name               = "ADC12_1";
ADC122.sampClkSrc          = "DL_ADC12_CLOCK_ULPCLK";
ADC122.sampClkDiv          = "DL_ADC12_CLOCK_DIVIDE_2";
ADC122.configureDMA        = true;
ADC122.sampCnt             = 1;
ADC122.enabledDMATriggers  = ["DL_ADC12_DMA_MEM0_RESULT_LOADED"];
ADC122.adcPin0Config.$name = "ti_driverlib_gpio_GPIOPinGeneric1";
ADC122.DMA_CHANNEL.$name   = "DMA_CH1";

const Board = scripting.addModule("/ti/driverlib/Board", {}, false);

CRC.bitReverse = "REVERSED";

const SYSCTL = scripting.addModule("/ti/driverlib/SYSCTL", {}, false);

TIMER1.$name     = "TIMER_0";
TIMER1.timerMode = "PERIODIC_UP";

TIMER2.$name = "TIMER_1";

TIMER3.$name = "TIMER_2";

/**
 * Pinmux solution for unlocked pins/peripherals. This ensures that minor changes to the automatic solver in a future
 * version of the tool will not impact the pinmux you originally saw.  These lines can be completely deleted in order to
 * re-solve from scratch.
 */
ADC121.peripheral.$suggestSolution             = "ADC1";
ADC121.peripheral.adcPin0.$suggestSolution     = "PA15";
ADC121.DMA_CHANNEL.peripheral.$suggestSolution = "DMA_CH1";
ADC122.peripheral.$suggestSolution             = "ADC0";
ADC122.peripheral.adcPin0.$suggestSolution     = "PA27";
ADC122.DMA_CHANNEL.peripheral.$suggestSolution = "DMA_CH0";
Board.peripheral.$suggestSolution              = "DEBUGSS";
Board.peripheral.swclkPin.$suggestSolution     = "PA20";
Board.peripheral.swdioPin.$suggestSolution     = "PA19";
SYSCTL.peripheral.$suggestSolution             = "SYSCTL";
TIMER1.peripheral.$suggestSolution             = "TIMG0";
TIMER2.peripheral.$suggestSolution             = "TIMA1";
TIMER3.peripheral.$suggestSolution             = "TIMA0";
